## src/modules/boat_differential/Kconfig
```kconfig
menuconfig MODULES_BOAT_DIFFERENTIAL
	bool "boat_differential"
	default n
	---help---
		Enable support for differential boats
```

## src/modules/boat_vectorthrust/Kconfig
```kconfig
menuconfig MODULES_BOAT_VECTORTHRUST
	bool "boat_vectorthrust"
	default n
	---help---
		Enable support for vector thrust boats
```
